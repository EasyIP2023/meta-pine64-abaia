## conf/layer.conf
```bitbake
# We have a conf and classes directory, add to BBPATH
BBPATH .= ":${LAYERDIR}"

# We have recipes-* directories, add to BBFILES
BBFILES += "${LAYERDIR}/recipes-*/*/*.bb \
            ${LAYERDIR}/recipes-*/*/*.bbappend"

BBFILE_COLLECTIONS += "meta-pine64-abaia"
BBFILE_PATTERN_meta-pine64-abaia = "^${LAYERDIR}/"
BBFILE_PRIORITY_meta-pine64-abaia = "6"

LAYERDEPENDS_meta-pine64-abaia = "core"
LAYERSERIES_COMPAT_meta-pine64-abaia = "dunfell"
```

## conf/machine/pinephone.conf
```bitbake
#@TYPE: Machine
#@NAME: Pinephone
#@DESCRIPTION: For the pinephone https://www.pine64.org/
#@ORIGINAL: https://github.com/webOS-ports/meta-pine64-luneos/blob/master/conf/machine/pinephone.conf

require conf/machine/include/arm/arch-arm64.inc
require conf/machine/include/a64.inc

EXTRA_IMAGEDEPENDS += "u-boot"
UBOOT_MACHINE ?= "pinephone_defconfig"

PREFERRED_PROVIDER_virtual/kernel ?= "linux-pinephone"
KERNEL_IMAGETYPE ?= "Image"
KERNEL_DEVICETREE ?= "allwinner/sun50i-a64-pinephone-1.2.dtb"

# https://wiki.archlinux.org/index.php/Silent_boot
# vga=current is the kernel argument that avoid weird behaviours like https://bugs.archlinux.org/task/32309
SBOOT_PARARMS = "quiet systemd.show_status=false vt.global_cursor_default=0"
KERNEL_ARGS ?= "root=/dev/mmcblk2p2 rootfstype=ext4 rw bootmode=normal ${SBOOT_PARARMS} console=tty3 console=ttyS0,115200n8 no_console_suspend earlycon=uart,mmio32,0x01c28000 panic=10 consoleblank=0 loglevel=3 cma=256M fbcon=logo-pos\:center"

IMAGE_FSTYPES += "wic.gz wic.bmap"
WKS_FILE ?= "pinephone-bsp-image.wks"

MACHINE_FEATURES = "alsa apm keyboard rtc serial screen touchscreen usbgadget usbhost vfat ext2 ext3 wifi"
MACHINE_EXTRA_RRECOMMENDS += "kernel-modules"
MACHINE_EXTRA_RDEPENDS = " \
    linux-firmware-pine64 \
    kernel-modules \
    "

IMAGE_BOOT_FILES ?= " \
    sun50i-a64-pinephone-1.2.dtb;sun50i-a64-pinephone.dtb \
    Image \
    boot.scr \
    abaia-logo.bmp \
    initramfs-uboot-image-pinephone.cpio.gz.u-boot;initramfs-uboot-image-pinephone.uboot \
    "

WKS_FILE_DEPENDS ?= " \
    mtools-native \
    dosfstools-native \
    virtual/bootloader \
    virtual/kernel \
    "

SERIAL_CONSOLES ?= "115200;ttyS0;tty0"

do_image_wic[depends] += "initramfs-uboot-image:do_image_complete"
```
